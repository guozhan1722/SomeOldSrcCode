## 2013_08_01/latest_build/package/adxl345/src/Kconfig
```kconfig
config INPUT_ADXL34X
         tristate "Analog Devices ADXL34x Three-Axis Digital Accelerometer"
         default n
         help
           Say Y here if you have a Accelerometer interface using the
           ADXL345/6 controller, and your board-specific initialization
           code includes that in its table of devices.
 
           This driver can use either I2C or SPI communication to the
           ADXL345/6 controller.  Select the appropriate method for
           your system.
 
           If unsure, say N (but it's safe to say "Y").
 
           To compile this driver as a module, choose M here: the
           module will be called adxl34x.
 
config INPUT_ADXL34X_I2C
         tristate "support I2C bus connection"
         depends on INPUT_ADXL34X && I2C
         default y
         help
           Say Y here if you have ADXL345/6 hooked to an I2C bus.
 
           To compile this driver as a module, choose M here: the
           module will be called adxl34x-i2c.
```

## 2013_08_01/latest_build/package/art_legacy_code/Config.in
```kconfig
config AT_LEGACY_ART_AR6000_COMM
	depends on PACKAGE_kmod-at-legacy-art
	bool "AR6000 ART interoperability"
	default n
	help
	  Enable this if you plan on using an AR6000 Linux ART as the other end.
	  Otherwise (for Windows PCI), disbable this.
```

## 2013_08_01/latest_build/package/mpci-bsp/src/Kconfig
```kconfig
config MPCI_BSP
	tristate "BSP support for the MPCI board"
	depends on @TARGET_ar71xx
```

## 2013_08_01/latest_build/package/vip-bsp/src/Kconfig
```kconfig
config VIP_BSP
	tristate "BSP support for the VIP2.0 board"
	depends on @TARGET_ixp4xx
```

## 2013_08_01/latest_build/target/linux/ar71xx/image/Config.in
```kconfig
config NANOPCI_UBOOT
	bool "Build U-Boot bootloader"
	depends TARGET_ar71xx
	default y

config UBOOT_TARGET
	string "U-Boot target board"
	depends TARGET_ar71xx
	depends NANOPCI_UBOOT
	default "pb42"
	help
	  For all supported boards there are ready-to-use default
		configurations available; just type "<board_name>".

config FACTORY_SERIAL_NUM
	string "factory setting unit serial #"
	depends TARGET_ar71xx
	depends NANOPCI_UBOOT
	default "1012000"
	help
	  This serial # is set up by the factory and can not changed by the user. This determines the mac address of the unit.

config UBOOT_IPADDR
	string "IP Address for U-Boot"
	depends TARGET_ar71xx
	depends NANOPCI_UBOOT
	default "192.168.1.39"
	help
	  IP address of device to be used in U-Boot

config UBOOT_SERVERIP
	string "IP Address of TFTP server"
	depends TARGET_ar71xx
	depends NANOPCI_UBOOT
	default "192.168.1.1"
	help
	  IP address of TFTP server for U-Boot
```
